## drivers/amlogic/thermal/Kconfig
```kconfig
# Amlogic Thermal


config AMLOGIC_THERMAL
    bool "amlogic thermal support"
    select THERMAL
    select CPU_THERMAL
    select GPU_THERMAL
    select CPUCORE_THERMAL
    select GPUCORE_THERMAL
    default n
    help
      This is the Amlogic Thermal interface driver
```
